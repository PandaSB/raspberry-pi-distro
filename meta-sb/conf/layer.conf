## meta-sb/conf/layer.conf
```bitbake
# We have a conf and classes directory, append to BBPATH
BBPATH .= ":${LAYERDIR}"

# We have a recipes directory, add to BBFILES
BBFILES += "${LAYERDIR}/recipes*/*/*.bb ${LAYERDIR}/recipes*/*/*.bbappend "

BBFILE_COLLECTIONS += "meta-sb"
BBFILE_PATTERN_meta-sb := "^${LAYERDIR}/"
BBFILE_PRIORITY_meta-sb = "8"
```
